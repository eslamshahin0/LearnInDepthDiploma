AUTOSAR XML (schema 00046)
package /INTERFACES
  sender receiver interface IF_SR_LidarData
    data LidarSensor: type=uint32
